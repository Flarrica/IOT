## Lab_Final_1/components/audio_player/Kconfig.projbuild
```kconfig
menu "Configuración de Placa Kaluga"

choice
    prompt "Versión de la Kaluga"
    default KALUGA_VERSION_1_2

config KALUGA_VERSION_1_2
    bool "Usar Kaluga v1.2"

config KALUGA_VERSION_1_3
    bool "Usar Kaluga v1.3"

endchoice

endmenu
```

## Lab_Final_1/main/Kconfig.projbuild
```kconfig
menu "Example Configuration"

    choice EXAMPLE_MODE
        prompt "Example mode"
        default EXAMPLE_MODE_MUSIC
        help
            Select example work mode

        config EXAMPLE_MODE_MUSIC
            bool "music"
        config EXAMPLE_MODE_ECHO
            depends on !EXAMPLE_BSP
            bool "echo"
    endchoice

    choice EXAMPLE_SELECT_MIC_GAIN
        prompt "Set MIC gain"
        depends on EXAMPLE_MODE_ECHO
        default MIC_GAIN_18DB
        help
            Select mic gain for echo mode

        config MIC_GAIN_0DB
            bool "0dB"
        config MIC_GAIN_6DB
            bool "6dB"
        config MIC_GAIN_12DB
            bool "12dB"
        config MIC_GAIN_18DB
            bool "18dB"
        config MIC_GAIN_24DB
            bool "24dB"
        config MIC_GAIN_30DB
            bool "30dB"
        config MIC_GAIN_36DB
            bool "36dB"
        config MIC_GAIN_42DB
            bool "42dB"
    endchoice

    config EXAMPLE_MIC_GAIN
        int
        default 0 if MIC_GAIN_0DB
        default 1 if MIC_GAIN_6DB
        default 2 if MIC_GAIN_12DB
        default 3 if MIC_GAIN_18DB
        default 4 if MIC_GAIN_24DB
        default 5 if MIC_GAIN_30DB
        default 6 if MIC_GAIN_36DB
        default 7 if MIC_GAIN_42DB

    config EXAMPLE_VOICE_VOLUME
        int "Voice volume"
        range 0 100
        default 80
        help
            Set voice volume

    config EXAMPLE_PA_CTRL_IO
        int "Power Amplifier control IO"
        default 53 if IDF_TARGET_ESP32P4
        default -1
        help
            Set GPIO number for PA control. Set -1 to disable PA control.

    config EXAMPLE_BSP
        bool "Enable Board Support Package (BSP) support"
        default n
        help
            Use BSP to setup all hardware settings. Specific board must be selected in main/idf_component.yml file.

    config BROKER_URL
        string "MQTT Broker URL"
        default "mqtt://192.168.1.100:1883"
        help
            Dirección del broker MQTT en formato URI. Ej: mqtt://192.168.1.100:1883

    config PARTITION_TABLE_CUSTOM
        bool "Usar tabla de particiones personalizada"
        default y

    config PARTITION_TABLE_FILENAME
        string "Archivo de tabla de particiones personalizada"
        default "particiones.csv"

    config ESPTOOLPY_FLASHSIZE_4MB
        bool "Flash de 4 MB"
        default y

    config RMT_SUPPRESS_DEPRECATE_WARN
        bool "Suprimir warnings deprecados en RMT"
        default y

    config ADC_SUPPRESS_DEPRECATE_WARN
        bool "Suprimir warnings deprecados en ADC"
        default y

    config DAC_SUPPRESS_DEPRECATE_WARN
        bool "Suprimir warnings deprecados en DAC"
        default y

    config I2S_SUPPRESS_DEPRECATE_WARN
        bool "Suprimir warnings deprecados en I2S"
        default y

    config I2C_ENABLE_SLAVE_DRIVER_VERSION_2
        bool "Habilitar versión nueva del driver I2C"
        default y

    config KALUGA_VERSION_1_2
        bool "Seleccionar Kaluga v1.2"
        default y

    config KALUGA_VERSION_1_3
        bool "Seleccionar Kaluga v1.3"
        default n

    config I2C_ENABLE_LEGACY_WARNINGS
        bool "Habilitar warnings legacy de I2C"
        default n

    config RMT_ENABLE_LEGACY_WARNINGS
        bool "Habilitar warnings legacy de RMT"
        default n

endmenu
```

## Lab_Final_1/sdkconfig.defaults
```kconfig
# Dirección del broker MQTT
CONFIG_BROKER_URL="mqtt://broker.hivemq.com"

# Activar uso de archivo CSV personalizado de particiones
CONFIG_PARTITION_TABLE_CUSTOM=y
CONFIG_PARTITION_TABLE_FILENAME="partitions.csv"
CONFIG_PARTITION_TABLE_CUSTOM_FILENAME="partitions.csv"

# Tamaño total de la flash (ajustable si usás más de 4 MB)
CONFIG_ESPTOOLPY_FLASHSIZE_4MB=y

# Suprimir warnings por uso de APIs obsoletas
CONFIG_RMT_SUPPRESS_DEPRECATE_WARN=y
CONFIG_ADC_SUPPRESS_DEPRECATE_WARN=y
CONFIG_DAC_SUPPRESS_DEPRECATE_WARN=y
CONFIG_I2S_SUPPRESS_DEPRECATE_WARN=y
CONFIG_ADC_CALI_SUPPRESS_DEPRECATE_WARN=y
# Usar versión nueva del driver I2C
CONFIG_I2C_ENABLE_SLAVE_DRIVER_VERSION_2=y

# Versión predeterminada de la Kaluga (solo una debe estar habilitada)
CONFIG_KALUGA_VERSION_1_2=y

# Desactivamos porque dan erores
CONFIG_ESP_WIFI_ENABLE_WPA3_SAE=n
CONFIG_ESP_WIFI_ENABLE_SAE_PK=n
CONFIG_ESP_WIFI_SOFTAP_SAE_SUPPORT=n
CONFIG_ESP_WIFI_ENABLE_WPA3_OWE_STA=n

# MQTT configuraciones
CONFIG_MQTT_PROTOCOL_5=y

# --- Configuración de SNTP ---
CONFIG_LWIP_SNTP_MAX_SERVERS=3
CONFIG_LWIP_DHCP_GET_NTP_SRV=n  
# o "y" si querés permitir NTP vía DHCP
CONFIG_LWIP_SNTP_UPDATE_DELAY=3600000  
# 1 hora (en milisegundos)

# --- Timer para gettimeofday ---
CONFIG_NEWLIB_TIME_SYSCALL_USE_RTC_HRT=y

# --- Para IPv6 si llegás a usarlo con pool.ntp.org ---
CONFIG_LWIP_IPV6=y
CONFIG_LWIP_IPV6_NUM_ADDRESSES=3



CONFIG_ESP_GDBSTUB_ENABLED=n
CONFIG_LWIP_SNTP=y
```
